## conf/machine/nanopi-m1-plus.conf
```bitbake
#@TYPE: Machine
#@NAME: NanoPi M1 Plus
#@DESCRIPTION: Machine configuration for the FriendlyARM NanoPi M1 Plus, based on the Allwinner H3 CPU

require conf/machine/include/sun8i.inc

KERNEL_DEVICETREE = "sun8i-h3-nanopi-m1-plus.dtb"
UBOOT_MACHINE = "nanopi_m1_plus_defconfig"
```

## conf/machine/orange-pi-pc-plus.conf
```bitbake
#@TYPE: Machine
#@NAME: orange-pi-pc-plus
#@DESCRIPTION: Machine configuration for the orange-pi-pc-plus, base on allwinner H3 CPU

require conf/machine/include/sun8i.inc

KERNEL_DEVICETREE = "sun8i-h3-orangepi-pc-plus.dtb"
UBOOT_MACHINE = "orangepi_pc_plus_defconfig"

PREFERRED_PROVIDER_virtual/mesa = "mesa-gl"
PREFERRED_PROVIDER_virtual/libgl = "mesa-gl"
PREFERRED_PROVIDER_virtual/libgles1 = "sunxi-mali-mainline"
PREFERRED_PROVIDER_virtual/libgles2 = "sunxi-mali-mainline"
PREFERRED_PROVIDER_virtual/egl = "sunxi-mali-mainline"
PREFERRED_PROVIDER_virtual/libgbm = "sunxi-mali-mainline"

MACHINE_ESSENTIAL_EXTRA_RRECOMMENDS_remove = "\
 kernel-module-mali \
 kernel-module-mali-drm \
  "

MACHINE_ESSENTIAL_EXTRA_RRECOMMENDS += "\
 kernel-module-sunxi-mali-mainline \
  "
```
